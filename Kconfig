## Kconfig
```kconfig
mainmenu "Gittup.org Configuration"

menu "Linux Kernel"
pushd "linux"
source "arch/x86/Kconfig"
popd
endmenu

menu "Binutils"
source "binutils/Kconfig"
endmenu

menu "uClibc"
pushd "uClibc"
source "extra/Configs/Config.in"
popd
endmenu

menu "busybox"
pushd "busybox"
source "Config.in"
popd
endmenu

menu "Support libraries"
source "ncurses/Kconfig"
source "zlib/Kconfig"
source "openssl/Kconfig"
endmenu

menu "Sound/Video"
pushd "mplayer"
source "Kconfig"
popd
endmenu

menu "Games"
source "nethack/Kconfig"
endmenu

menu "Networking Utilities"
source "openssh/Kconfig"
endmenu

menu "gittup.org initial ramdisk"
source "initrd/Kconfig"
endmenu

menu "gittup.org web"
source "html/Kconfig"
endmenu
```

## html/Kconfig
```kconfig
config GITTUP_WEB
	bool "gittup web images"
	default n
	help
	  Uses graphviz to generate .png files from .dot files for the
	  gittup.org website.

	  Say n here unless you want to view the web pages locally, or create
	  your own gittup.org website.
```

## initrd/Kconfig
```kconfig
config GITTUP_INITRD
	bool "Build initial ramdisk"
	depends on BLK_DEV_INITRD
	depends on MKNOD
	depends on FEATURE_SH_IS_ASH
	default n
	help
	  Builds the ramdisk for gittup.org. This essentially functions as the root filesystem, since there is no real root filesystem.
```
